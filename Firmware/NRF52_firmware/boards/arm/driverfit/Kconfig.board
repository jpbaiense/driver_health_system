## Firmware/NRF52_firmware/boards/arm/driverfit/Kconfig.board
```kconfig
# Copyright (c) 2023 Nordic Semiconductor ASA
# SPDX-License-Identifier: Apache-2.0

config BOARD_DRIVERFIT
	bool "DriverFit"
	depends on SOC_NRF52832_QFAA
```

## Firmware/NRF52_firmware/boards/arm/driverfit/Kconfig.defconfig
```kconfig
# Copyright (c) 2023 Nordic Semiconductor ASA
# SPDX-License-Identifier: Apache-2.0

if BOARD_DRIVERFIT

config BOARD
	default "driverfit"

config BT_CTLR
   default BT

endif
```

## Firmware/NRF52_firmware/build/Kconfig/Kconfig.shield
```kconfig
osource "c:/users/silva/documents/mestrado/tese/driverfit_workspace/project/boards/shields/*/Kconfig.shield"
osource "C:/ncs/v2.5.0/nrf/boards/shields/*/Kconfig.shield"
```

## Firmware/NRF52_firmware/build/Kconfig/Kconfig.shield.defconfig
```kconfig
osource "c:/users/silva/documents/mestrado/tese/driverfit_workspace/project/boards/shields/*/Kconfig.defconfig"
osource "C:/ncs/v2.5.0/nrf/boards/shields/*/Kconfig.defconfig"
```
