## Firmware/driveguardian/build/Kconfig/Kconfig.shield
```kconfig
osource "c:/ncs/thesis_board/boards/shields/*/Kconfig.shield"
osource "C:/ncs/v2.5.0/nrf/boards/shields/*/Kconfig.shield"
```

## Firmware/driveguardian/build/Kconfig/Kconfig.shield.defconfig
```kconfig
osource "c:/ncs/thesis_board/boards/shields/*/Kconfig.defconfig"
osource "C:/ncs/v2.5.0/nrf/boards/shields/*/Kconfig.defconfig"
```
